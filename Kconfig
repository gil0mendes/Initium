## Kconfig
```kconfig
#
# The MIT License (MIT)
#
# Copyright (c) 2015 Gil Mendes <gil00mendes@gmail.com>
#
# Permission is hereby granted, free of charge, to any person obtaining a copy
# of this software and associated documentation files (the "Software"), to deal
# in the Software without restriction, including without limitation the rights
# to use, copy, modify, merge, publish, distribute, sublicense, and/or sell
# copies of the Software, and to permit persons to whom the Software is
# furnished to do so, subject to the following conditions:
#
# The above copyright notice and this permission notice shall be included in all
# copies or substantial portions of the Software.
#
# THE SOFTWARE IS PROVIDED "AS IS", WITHOUT WARRANTY OF ANY KIND, EXPRESS OR
# IMPLIED, INCLUDING BUT NOT LIMITED TO THE WARRANTIES OF MERCHANTABILITY,
# FITNESS FOR A PARTICULAR PURPOSE AND NONINFRINGEMENT. IN NO EVENT SHALL THE
# AUTHORS OR COPYRIGHT HOLDERS BE LIABLE FOR ANY CLAIM, DAMAGES OR OTHER
# LIABILITY, WHETHER IN AN ACTION OF CONTRACT, TORT OR OTHERWISE, ARISING FROM,
# OUT OF OR IN CONNECTION WITH THE SOFTWARE OR THE USE OR OTHER DEALINGS IN THE
# SOFTWARE.
#

mainmenu "Initium Configuration"

####################
menu "Build options"
####################

config CROSS_COMPILER
    string "Cross-compiler prefix"
    default ""
    help
        Prefix for cross-compiler utilities, e.g. /usr/cross/bin/i686-elf-
        If empty, the system's default compiler will be used.

config EXTRA_CCFLAGS
    string "Extra CCFLAGS"
    default ""
    help
        Extra options for the C compiler.

#######
endmenu
#######

comment "Target system"

source "config/Kconfig.arch"
source "config/Kconfig.platform"

comment "Feature configuration"

config DEBUG
    bool "Debug build"
    default y
    help
        Enable various sections of debugging code and extra checks. This will
        increse the size f the loader binary, so don't enavle it unless
        necessary.

source "source/Kconfig"
```

## source/platform/bios/Kconfig
```kconfig
config FS_ISO9660
    def_bool y

config TARGET_HAS_DISK
    def_bool y

config TARGET_HAS_NET
  def_bool y

config TARGET_HAS_UI
    def_bool y

config TARGET_HAS_VIDEO
    def_bool y

config DRIVER_SERIAL_NS16550
    def_bool y

config TARGET_NS16550_IO
    def_bool y

config DRIVER_CONSOLE_VGA
    def_bool y
```

/**
* The MIT License (MIT)
*
* Copyright (c) 2015 Gil Mendes
*
* Permission is hereby granted, free of charge, to any person obtaining a copy
* of this software and associated documentation files (the "Software"), to deal
* in the Software without restriction, including without limitation the rights
* to use, copy, modify, merge, publish, distribute, sublicense, and/or sell
* copies of the Software, and to permit persons to whom the Software is
* furnished to do so, subject to the following conditions:
*
* The above copyright notice and this permission notice shall be included in all
* copies or substantial portions of the Software.
*
* THE SOFTWARE IS PROVIDED "AS IS", WITHOUT WARRANTY OF ANY KIND, EXPRESS OR
* IMPLIED, INCLUDING BUT NOT LIMITED TO THE WARRANTIES OF MERCHANTABILITY,
* FITNESS FOR A PARTICULAR PURPOSE AND NON INFRINGEMENT. IN NO EVENT SHALL THE
* AUTHORS OR COPYRIGHT HOLDERS BE LIABLE FOR ANY CLAIM, DAMAGES OR OTHER
* LIABILITY, WHETHER IN AN ACTION OF CONTRACT, TORT OR OTHERWISE, ARISING FROM,
* OUT OF OR IN CONNECTION WITH THE SOFTWARE OR THE USE OR OTHER DEALINGS IN THE
* SOFTWARE.
*/

/**
 * @file
 * @brief               IA32 test kernel linker script.
 */

#include <arch/page.h>

ENTRY(kmain)
OUTPUT_ARCH("i386")
OUTPUT_FORMAT("elf32-i386")

SECTIONS {
    . = 0xc0000000 + SIZEOF_HEADERS;

    .text : {
        __text_start = .;
        *(.text)
        *(.text.*)
        . = ALIGN(PAGE_SIZE);
        __text_end = .;
    }

    .notes : {
        *(.note.*)
    }

    .rodata ALIGN(PAGE_SIZE) : {
        __rodata_start = .;
        *(.rodata)
        *(.rodata.*)
        . = ALIGN(PAGE_SIZE);
        __rodata_end = .;
    }

    .data ALIGN(PAGE_SIZE) : {
        __data_start = .;
        *(.data)
        *(.data.*)
        . = ALIGN(PAGE_SIZE);
        __data_end = .;
    }

    .bss ALIGN(PAGE_SIZE) : {
        __bss_start = .;
        *(.bss)
        *(.bss.*)
        *(COMMON)
        . = ALIGN(PAGE_SIZE);
        __bss_end = .;
    }

    __end = .;

    /DISCARD/ : {
        *(.note.GNU-stack)
        *(.comment*)
    }
}

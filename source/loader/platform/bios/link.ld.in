/*
 * Copyright (C) 2012-2014 Gil Mendes
 *
 * Permission is hereby granted, free of charge, to any person obtaining a copy of
 * this software and associated documentation files (the "Software"), to deal in
 * the Software without restriction, including without limitation the rights to
 * use, copy, modify, merge, publish, distribute, sublicense, and/or sell copies of
 * the Software, and to permit persons to whom the Software is furnished to do so,
 * subject to the following conditions:
 *
 * The above copyright notice and this permission notice shall be included in all
 * copies or substantial portions of the Software.
 *
 * THE SOFTWARE IS PROVIDED "AS IS", WITHOUT WARRANTY OF ANY KIND, EXPRESS OR
 * IMPLIED, INCLUDING BUT NOT LIMITED TO THE WARRANTIES OF MERCHANTABILITY, FITNESS
 * FOR A PARTICULAR PURPOSE AND NONINFRINGEMENT. IN NO EVENT SHALL THE AUTHORS OR
 * COPYRIGHT HOLDERS BE LIABLE FOR ANY CLAIM, DAMAGES OR OTHER LIABILITY, WHETHER
 * IN AN ACTION OF CONTRACT, TORT OR OTHERWISE, ARISING FROM, OUT OF OR IN
 * CONNECTION WITH THE SOFTWARE OR THE USE OR OTHER DEALINGS IN THE SOFTWARE.
 */

/**
 * @file
 * @brief		BIOS loader linker script.
 */

#include <arch/page.h>

#include <platform/loader.h>

OUTPUT_FORMAT("elf32-i386")
OUTPUT_ARCH("i386")

SECTIONS {
	. = LOADER_LOAD_ADDR;
	__start = .;

	.text : {
		__text_start = .;

		/* Init code in start.S must be placed first: execution begins
		 * from the very start of the loader image. */
		*(.init.text)

		*(.text)
		*(.text.*)
		__text_end = .;
	}

	.rodata ALIGN(32) : {
		__rodata_start = .;
		*(.rodata)
		*(.rodata.*)
		__rodata_end = .;
	}

	.data ALIGN(32) : {
		__data_start = .;
		*(.data)
		*(.data.*)
		__data_end = .;
	}

	.bss ALIGN(32) : {
		__bss_start = .;
		*(.bss)
		*(.bss.*)
		*(COMMON)
		__bss_end = .;
	}

	. = ALIGN(PAGE_SIZE);
	__end = .;

	/DISCARD/ : {
		*(.note.*)
		*(.comment*)
		*(.eh_frame*)
	}
}

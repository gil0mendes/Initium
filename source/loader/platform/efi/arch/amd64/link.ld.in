/**
 * The MIT License (MIT)
 *
 * Copyright (c) 2014 Gil Mendes
 *
 * Permission is hereby granted, free of charge, to any person obtaining a copy
 * of this software and associated documentation files (the "Software"), to deal
 * in the Software without restriction, including without limitation the rights
 * to use, copy, modify, merge, publish, distribute, sublicense, and/or sell
 * copies of the Software, and to permit persons to whom the Software is
 * furnished to do so, subject to the following conditions:
 *
 * The above copyright notice and this permission notice shall be included in all
 * copies or substantial portions of the Software.
 *
 * THE SOFTWARE IS PROVIDED "AS IS", WITHOUT WARRANTY OF ANY KIND, EXPRESS OR
 * IMPLIED, INCLUDING BUT NOT LIMITED TO THE WARRANTIES OF MERCHANTABILITY,
 * FITNESS FOR A PARTICULAR PURPOSE AND NONINFRINGEMENT. IN NO EVENT SHALL THE
 * AUTHORS OR COPYRIGHT HOLDERS BE LIABLE FOR ANY CLAIM, DAMAGES OR OTHER
 * LIABILITY, WHETHER IN AN ACTION OF CONTRACT, TORT OR OTHERWISE, ARISING FROM,
 * OUT OF OR IN CONNECTION WITH THE SOFTWARE OR THE USE OR OTHER DEALINGS IN THE
 * SOFTWARE.
 */

/**
 * @file
 * @brief		AMD64 EFI loader linker script.
 */

#include <arch/page.h>

OUTPUT_FORMAT("elf64-x86-64")
OUTPUT_ARCH("i386:x86-64")
ENTRY(_start)

SECTIONS {
	. = 0;
	__start = .;

	.hash : { *(.hash) }
  .gnu.hash : { *(.gnu.hash) }

	. = ALIGN(PAGE_SIZE);
	.text : {
		__text_start = .;
		*(.text)
		*(.text.*)
		__text_end = .;
	}

	/* Dummy relocation section for the PE binary so that EFI recognizes
	 * as as a relocatable image. */
	. = ALIGN(PAGE_SIZE);
	.reloc : { *(.reloc) }

	. = ALIGN(PAGE_SIZE);
	.data : {
		/* Roll the read-only data into the main data section. It would
     * not be write protected even if we put it separately, and PE
     * requires page aligned sections so we only waste space by
     * splitting it into another section. */
		__rodata_start = .;
		*(.rodata)
		*(.rodata.*)
		__rodata_end = .;

		*(.got)
		*(.got.plt)

		__data_start = .;
		*(.data)
		*(.data.*)
		__data_end = .;
	}

	. = ALIGN(PAGE_SIZE);
	.dynamic : { *(.dynamic) }

	. = ALIGN(PAGE_SIZE);
	.rela : {
		*(.rela.data*)
		*(.rela.got)
	}

	. = ALIGN(PAGE_SIZE);
	.dynsym   : { *(.dynsym) }

	. = ALIGN(PAGE_SIZE);
	.dynstr   : { *(.dynstr) }

	. = ALIGN(PAGE_SIZE);
	.bss : {
		__bss_start = .;
		*(.dynbss)
		*(.bss)
		*(.bss.*)
		*(COMMON)
		__bss_end = .;
	}

	. = ALIGN(PAGE_SIZE);
	__end = .;

	/DISCARD/ : {
		*(.note.*)
		*(.comment*)
		*(.eh_frame*)

		/* Don't need ELF relocations for the dummy PE relocations. */
		*(.rela.reloc)
	}
}
